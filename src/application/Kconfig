## src/application/Kconfig
```kconfig
#===============================================================================
# @brief    Kconfig file.
# Copyright (c) @CompanyNameMagicTag 2023-2023. All rights reserved.
#===============================================================================

config SAMPLE_ENABLE
    bool
    prompt "Enable Sample."
    default n
    help
        This option means support Samples.

if SAMPLE_ENABLE
osource "application/samples/Kconfig"
endif

osource "application/ws63/Kconfig"

config PORTING_XF_ENABLE
    bool
    prompt "Enable porting XF."
    default y
    help
        This option means support porting XF.

if PORTING_XF_ENABLE
choice
    prompt "WS63 PORTING XF VERSION."
    default WS63_PORTING_XF_V0_2_X
    config  WS63_PORTING_XF_V0_2_X
        bool "XF V0.2.x"
endchoice

config WS63_PORTING_XF_VERSION
    int 
    default 2 if WS63_PORTING_XF_V0_2_X

if WS63_PORTING_XF_V0_2_X
osource "application/ws63_porting_xf_0p2/Kconfig"
endif

endif
```

## src/application/ws63_porting_xf_0p2/tasks_xf_entry/Kconfig
```kconfig
#===============================================================================
# @brief    Kconfig file.
# Copyright (c) @CompanyNameMagicTag 2023-2023. All rights reserved.
#===============================================================================

if WS63_PORTING_XF_V0_2_X

    menu "tasks_xf_entry configuration"
    
        config TASKS_XF_PREMAIN_STACK_SIZE
            int
            prompt "tasks_xf_premain() task stack size."
            default 8192
    
        config TASKS_XF_PREMAIN_PRIORITY
            int
            prompt "tasks_xf_premain() task priority."
            default 24
            range 0 31
            help
                Set the priority of the tasks_xf_premain() task.
                0 is the highest and 31 is the lowest.
    
    endmenu # "tasks_xf_entry Configuration"

endif # WS63_PORTING_XF_V0_2_X
```
